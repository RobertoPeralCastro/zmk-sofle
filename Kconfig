## config/dts/bindings/behaviors/zmk,behavior-dyn-kp.yaml
```yaml
# SPDX-License-Identifier: MIT

description: Dynamic keypress behavior

compatible: "zmk,behavior-dyn-kp"

include: one_param.yaml

properties:
  label:
    type: string
    required: false
  "#sensor-binding-cells":
    type: int
    required: true
    const: 1
```

## config/dts/bindings/behaviors/zmk,behavior-unicode.yaml
```yaml
description: ZMK Unicode behavior

compatible: "zmk,behavior-unicode"

#binding-cells: <0>

properties:
  unicode:
    type: int
    required: true
    description: Unicode code point to emit
```

## west.yml
```yaml
manifest:
  version: "0.13"
  remotes:
    - name: zmkfirmware
      url-base: https://github.com/zmkfirmware
    - name: RobertoPeralCastro
      url-base: https://github.com/RobertoPeralCastro
  projects:
    - name: zmk
      remote: zmkfirmware
      revision: main
      clone-depth: 1
    - name: eyelash_sofle
      remote: RobertoPeralCastro
      revision: main
      path: eyelash_sofle
  self:
    path: config
```
